## conf/distro/winlink.conf
```bitbake
DISTRO = "winlink"
DISTRO_NAME = "Winlink - ${WINLINK_CLIENT}"
DISTRO_VERSION = "0.2.0"

MAINTAINER = "james-cws VA7ADG <james@coastwide.systems>"

LOCALCONF_VERSION = "2"

INIT_MANAGER = "systemd"

INHERIT:append = " poky-sanity"

DISTRO_FEATURES ?= "systemd systemd-resolved usrmerge ipv4 ipv6 wifi"

# Set which Winlink client to add to the build, defaults to pat
# Possible options:
# pat
WINLINK_CLIENT ??= "pat"
GOVERSION="1.19%"
# NOTE: GOVERSION & the backported go package should be removed when
#       Scarthgap support is added (Scarthgap releases in Apr 2024)

hostname:pn-base-files = "${MACHINE}-winlink"
```
